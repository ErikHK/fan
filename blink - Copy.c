#define F_CPU 20000000UL

/* A simple ADC example that checks the analog reading on ADC0 and turns
 * an LED on if the reading is higher than a threshold value and turns if
 * off if it is under that value. */
#include <avr/io.h>
#include <stdint.h>
#include <util/delay.h>
#include <avr\interrupt.h>
#include <avr/pgmspace.h>
#include <math.h>

/*
const uint8_t sinewave[] PROGMEM = //256 values
{
0x80,0x83,0x86,0x89,0x8c,0x8f,0x92,0x95,0x98,0x9c,0x9f,0xa2,0xa5,0xa8,0xab,0xae,
0xb0,0xb3,0xb6,0xb9,0xbc,0xbf,0xc1,0xc4,0xc7,0xc9,0xcc,0xce,0xd1,0xd3,0xd5,0xd8,
0xda,0xdc,0xde,0xe0,0xe2,0xe4,0xe6,0xe8,0xea,0xec,0xed,0xef,0xf0,0xf2,0xf3,0xf5,
0xf6,0xf7,0xf8,0xf9,0xfa,0xfb,0xfc,0xfc,0xfd,0xfe,0xfe,0xff,0xff,0xff,0xff,0xff,
0xff,0xff,0xff,0xff,0xff,0xff,0xfe,0xfe,0xfd,0xfc,0xfc,0xfb,0xfa,0xf9,0xf8,0xf7,
0xf6,0xf5,0xf3,0xf2,0xf0,0xef,0xed,0xec,0xea,0xe8,0xe6,0xe4,0xe2,0xe0,0xde,0xdc,
0xda,0xd8,0xd5,0xd3,0xd1,0xce,0xcc,0xc9,0xc7,0xc4,0xc1,0xbf,0xbc,0xb9,0xb6,0xb3,
0xb0,0xae,0xab,0xa8,0xa5,0xa2,0x9f,0x9c,0x98,0x95,0x92,0x8f,0x8c,0x89,0x86,0x83,
0x80,0x7c,0x79,0x76,0x73,0x70,0x6d,0x6a,0x67,0x63,0x60,0x5d,0x5a,0x57,0x54,0x51,
0x4f,0x4c,0x49,0x46,0x43,0x40,0x3e,0x3b,0x38,0x36,0x33,0x31,0x2e,0x2c,0x2a,0x27,
0x25,0x23,0x21,0x1f,0x1d,0x1b,0x19,0x17,0x15,0x13,0x12,0x10,0x0f,0x0d,0x0c,0x0a,
0x09,0x08,0x07,0x06,0x05,0x04,0x03,0x03,0x02,0x01,0x01,0x00,0x00,0x00,0x00,0x00,
0x00,0x00,0x00,0x00,0x00,0x00,0x01,0x01,0x02,0x03,0x03,0x04,0x05,0x06,0x07,0x08,
0x09,0x0a,0x0c,0x0d,0x0f,0x10,0x12,0x13,0x15,0x17,0x19,0x1b,0x1d,0x1f,0x21,0x23,
0x25,0x27,0x2a,0x2c,0x2e,0x31,0x33,0x36,0x38,0x3b,0x3e,0x40,0x43,0x46,0x49,0x4c,
0x4f,0x51,0x54,0x57,0x5a,0x5d,0x60,0x63,0x67,0x6a,0x6d,0x70,0x73,0x76,0x79,0x7c
};
*/

const __flash uint8_t sineLookupTable[] = {
128, 131, 134, 137, 140, 143, 146, 149,
152, 155, 158, 162, 165, 167, 170, 173,
176, 179, 182, 185, 188, 190, 193, 196,
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103, 106, 109, 112, 115, 118, 121, 124};


//const uint8_t triangle[] PROGMEM = {0x0, 0x10, 0x20, 0x30, 0x40, 0x50, 0x60, 0x70, 0x80, 0x90, 0xa0, 0xb0, 0xc0, 0xb0, 0xa0, 0x90, 0x80, 0x70, 0x60, 0x50, 0x40, 0x30, 0x20, 0x10, 0};

const __flash uint8_t triangle[] = {0, 2, 4, 6, 8, 10, 12, 14, 16, 18, 20, 22, 24,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 2, 0};

//186 values in violin
const __flash uint8_t violin[] = {13, 30, 56, 85, 111, 130, 141, 146, 146, 146, 145, 146, 150,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 189, 196};

//268 values in violin2
const __flash uint8_t violin2[] = {247, 246, 246, 246, 245, 245, 244, 242, 242, 241, 238, 236, 233,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 225, 227};

//255 values organ
const __flash uint8_t organ[] = {248, 250, 251, 249, 244, 238, 229, 219, 208, 197, 186, 176, 168,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 245, 246};

const __flash uint8_t saw1[] = {0,1,2,3,4,5,6,7,8,9,10,11,12,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254,255};
const __flash uint8_t saw2[] = {0,2,4,6,8,10,12,14,16,18,20,22,24,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252,254};
const __flash uint8_t saw3[] = {0,3,6,9,12,15,18,21,24,27,30,33,36,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249,252};
const __flash uint8_t saw4[] = {0,4,8,12,16,20,24,28,32,36,40,44,48,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248,252};

//1608 samples dog barks
const __flash uint8_t dogbark[] = {137,137,138,137,138,137,137,138,137,137,137,138,137,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138,};



/* Which analog pin we want to read from.  The pins are labeled "ADC0"
 * "ADC1" etc on the pinout in the data sheet.  In this case ADC_PIN
 * being 0 means we want to use ADC0.  On the ATmega328P this is also
 * the same as pin PC0 */
#define ADC_PIN			0	

/* Just the pin we are going to be connecting the LED to PB0 is the same
 * as PIN0 but since we will be using PORTB it makes sense to use the 
 * name PB0 */
#define	LED_PIN			PB0	

/* The ADC value we will consider the cutoff point for turning the LED
 * on or off.  The ADC we are using is 10-bits so can be a value from
 * 0 to 1023.  The value 0 means that there is no voltage on the ADC pin
 * and the value 1023 means the voltage has reached the voltage on the 
 * AREF pin. */
#define ADC_THRESHOLD	400

/* This function just keeps the reading code out of the loop itself.
 * It takes the analog pin number as a parameter and returns the
 * analog reading on that pin as a result.
 *
 * Look for its definition below main. */
uint16_t adc_read(uint8_t adcx);


uint8_t i=0;
uint8_t adc=1;
uint8_t resmic=1;

uint8_t vol = 0;
uint8_t targetvol = 0;

uint16_t mic_counter = 0;

uint16_t mic_read_counter = 0;

uint16_t softpot_read_counter = 0;

uint16_t vol_counter = 0;

uint16_t tremolo_counter = 0;

uint8_t tremolo_index = 0;

#define MICBIAS 511

uint16_t min = MICBIAS;
uint16_t max = MICBIAS;

double val= 0;

uint8_t flipByte(uint8_t c)
     {
       c = ((c>>1)&0x55)|((c<<1)&0xAA);
       c = ((c>>2)&0x33)|((c<<2)&0xCC);
       c = (c>>4) | (c<<4) ;

       return c;
     }


ISR(TIMER1_COMPA_vect)
{
  
  //uint8_t jump = i;
  
  //uint16_t tmp = vol * pgm_read_byte(&sineLookupTable[i]);
  
  
  //PORTB = (uint8_t) (tmp >> 11);
  
  //PORTB = i>>3;
  
  //PORTB = sinewave[i];
  
  //val = 250 * sin(i);
  
  //uint16_t tmp = vol * pgm_read_byte(&triangle[i]);
  //PORTD = tmp>>8;
  
  //uint16_t tmp = (vol * i);
  
  //add tremolo
  //tmp =  tmp + pgm_read_byte(&triangle[tremolo_index])>>2;
  
  
  
  //PORTD = tmp>>8;
 
  i+=1;
  
  
  //uint16_t viol = vol * i;
  //uint16_t organ2 = vol * organ[i];
  uint16_t sawsum = vol * ( saw1[i] + saw2[i] + saw3[i] + saw4[i]);
  
  
  PORTD = (uint8_t) (sawsum>>10);
  
}


void delay_ms(uint16_t ms)
{
	while(--ms)
		_delay_ms(1);
}




int map_values(int diff, int start, int stop, int interval_ms, int interval_vals)
{
	uint16_t vol = 0;
	
	//no volume if it's smaller than start!
	if(diff < start)
		return 0;
	
	
	for(int i = 1; i < (stop-start) / interval_ms; i++ )
	{
		//if(diff < )
	}
	
	
	
	
	
	
	
	return vol;
}




int main(void) {
	
	//DDRC = 0xff;
	//PORTC = 0x00;
	
	MCUCR |= (1 << PUD);
	
	//set as input
	DDRC = 0x00;
	//Disable internal pull ups
	PORTC=0x00;
	//Set PORTB1 pin as output
	DDRB=0xFF;
	DDRD = 0xFF;
	// initial OCR1A value
	//OCR1A=3;
	
	//OCR1A = 0x01FF;
	
	
	

	//TCCR1A = (1 << COM1A1) | (1 << COM1B0) | (1 << WGM10) | (1 << WGM11);
	
	TCCR1A = (1 << WGM10) | (1 << WGM11);
	
	
	//start timer without prescaler
	//TCCR1B=0x01;
	TCCR1B |= (1 << CS10) | (1 << WGM13) | (1 << WGM12);
	
	
	TIMSK1 = (1 << OCIE1A);
	
	
	OCR1A = 0x0B18;
	

	
	//enable global interrups
	sei();
	
	
	
	


	ADCSRA = 0x87;
	/* Enable the ADC */
	ADCSRA |= _BV(ADEN);
	
	//ADCSRA |= (1 << ADATE);

	/* Set the LED pin as an output. */
	//DDRB  |= _BV(LED_PIN);


	/* continually check if the ADC value is greater than the
	 * defined ADC_THRESHOLD value above.  If it is turn the LED on,
	 * if it isn't turn it off. */
	for (;;) {
		
		uint16_t res = adc_read(0);
		
		//if half steps!!
		//uint8_t test = (res) / 42.6666;
		//double test__ = test / 12.0;
		
		//otherwise 
		double test__ = res / 512.0;
		
		
		double test2 = 153 * pow(2, test__ ) + 10* ((sineLookupTable[tremolo_index]) / 540.0);



		if(softpot_read_counter > 100)
		{
			
			//if(  (res > 0 && res < 540)  || (res > 600  &&  res < 1024) )
			if( res > 140 && res < 1000 )
			{
				//DDRB = 0xff;
				OCR1A = (uint16_t) (test2);
				//vol = 0xffff;
				//vol = 5;
				//OCR1A = res*63;
			}
			else
			{
				//targetvol = 0;
				//vol = 0;
				//OCR1A = 0;
			}
			
			softpot_read_counter = 0;
		}
		
		//OCR1A = 0x0b18>>3;
		
		
		
		uint16_t mic = adc_read(4);
		

		//_delay_ms(40);
		if(mic_read_counter > 10)
		{
			if(mic > 0 && mic < 1024)
			{
				
				//checka om mic < min, isåfall sätt min
				if(mic < min)
					min = mic;
				
				if(mic > max)
					max = mic;
				
				uint16_t diff = max-min;
				
				
				
				/*
				if(diff < 50)
					vol = 0;
				else if(diff < 100)
					vol = 8;
				else if(diff < 130)
					vol = 16;
				else if(diff < 160)
					vol = 32;
				else if(diff < 190)
					vol = 40;
				else if(diff < 220)
					vol = 48;
				else if(diff < 250)
					vol = 56;
				else if(diff < 280)
					vol = 64;
				else if(diff < 310)
					vol = 72;
				else if(diff < 340)
					vol = 80;
				else if(diff < 370)
					vol = 88;
				else if(diff < 400)
					vol = 96;
				else if(diff < 430)
					vol = 104;
				else if(diff < 460)
					vol = 112;
				else if(diff < 490)
					vol = 127;
				
				else if(diff < 520)
					vol = 136;
				else if(diff < 550)
					vol = 144;
				else if(diff < 580)
					vol = 154;
				else
					vol = 154;
				
				
				else
					vol = 127;
				
				vol *= 2;
				*/
				
				/*
				if(diff < 350)
					targetvol = 0;
				
				else if(diff < 400)
					targetvol = 40;
				else if(diff < 450)
					targetvol = 80;
				else if(diff < 500)
					targetvol = 100;
				else if(diff < 550)
					targetvol = 120;
				else if(diff < 600)
					targetvol = 140;
				else if(diff < 650)
					targetvol = 160;
				else if(diff < 700)
					targetvol = 180;
				else if(diff < 800)
					targetvol = 200;
				else if(diff < 900)
					targetvol = 220;
				else if(diff < 1024)
					targetvol = 240;
				
				*/
				
				
				/*
				if(diff < 20)
					targetvol = 0;
				
				else if(diff < 40)
					targetvol = 1;
				
				else if(diff < 60)
					targetvol = 2;
				
				else if(diff < 90)
					targetvol = 3;
				
				else if(diff < 120)
					targetvol = 4;
				
				else if(diff < 150)
					targetvol = 8;
				
				else if(diff < 180)
					targetvol = 10;
				
				else if(diff < 210)
					targetvol = 20;
				
				else if(diff < 240)
					targetvol = 30;
				
				else if(diff < 270)
					targetvol = 40;
				
				else if(diff < 300)
					targetvol = 50;
				
				else if(diff < 330)
					targetvol = 60;
				
				else if(diff < 360)
					targetvol = 70;
				
				else if(diff < 390)
					targetvol = 80;

				
				else if(diff < 1024)
					targetvol = 100;
				
				*/
				
				
				
				if (diff < 20)
					targetvol = 0;
				else
				
					targetvol = diff >> 2;
				
				
			}
			
			mic_read_counter = 0;
		}
		
		
		
		mic_counter++;
		
		mic_read_counter++;
		
		vol_counter++;
		
		softpot_read_counter++;
	

		tremolo_counter++;
		
		
		if(tremolo_counter > 2)
		{
			tremolo_index++;
			
			
			tremolo_counter = 0;
		}
		
	
		if(vol_counter > 30)
		{
			
			if(targetvol > vol)
				vol++;
			if(targetvol < vol)
				vol--;
			
			vol_counter = 0;
		}
		
		
		//reset values after x ms
		if(mic_counter >= 100)
		{
			min = 1023;
			max = 0;
		
			
			//vol++;
			//if(vol > 254)
			//	vol = 0;
			
			
			mic_counter = 0;
		}			
		
		
		
	
    }

}

uint16_t adc_read(uint8_t adcx) {
	/* adcx is the analog pin we want to use.  ADMUX's first few bits are
	 * the binary representations of the numbers of the pins so we can
	 * just 'OR' the pin's number with ADMUX to select that pin.
	 * We first zero the four bits by setting ADMUX equal to its higher
	 * four bits. */
	ADMUX	&=	0xf0;
	
	//ADMUX = (1 << ADLAR);
	
	//ADMUX = (1 << ADLAR) | (1 << REFS0) | (1 << REFS1);
	ADMUX	|=	adcx;

	//ADMUX = 0x87;

	/* This starts the conversion. */
	ADCSRA |= _BV(ADSC);

	/* This is an idle loop that just wait around until the conversion
	 * is finished.  It constantly checks ADCSRA's ADSC bit, which we just
	 * set above, to see if it is still set.  This bit is automatically
	 * reset (zeroed) when the conversion is ready so if we do this in
	 * a loop the loop will just go until the conversion is ready. */
	while ( (ADCSRA & _BV(ADSC)) );

	/* Finally, we return the converted value to the calling function. */
	return ADC;
}